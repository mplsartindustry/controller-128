/*

    controller-128
    Copyright (c) 2020 held jointly by the individual authors.

    This file is part of controller-128.

    controller-128 is free software: you can redistribute it and/or modify
    it under the terms of the GNU General Public License as published by
    the Free Software Foundation, either version 3 of the License, or
    (at your option) any later version.

    controller-128 is distributed in the hope that it will be useful,
    but WITHOUT ANY WARRANTY; without even the implied warranty of
    MERCHANTABILITY or FITNESS FOR A PARTICULAR PURPOSE.  See the
    GNU General Public License for more details.

    You should have received a copy of the GNU General Public License
    along with controller-128.  If not, see <http://www.gnu.org/licenses/>.

*/

class LCD {
  private static final int WIDTH = 16;
  private static final int HEIGHT = 2;
  private static final int ROW_STRIDE = 40;
  
  private char[] contents;
  private boolean displaying;
  private int cursorPos;
  private int scrollOffset;
  
  public LCD() {
    contents = new char[ROW_STRIDE * 2];
    this.clear();
    this.home();
  }
  
  void clear() {
    for (int i = 0; i < contents.length; i++) {
      contents[i] = ' ';
    }
    displaying = true;
  }
  
  void home() {
    cursorPos = 0;
    scrollOffset = 0;
  }
  
  void setCursor(int col, int row) {
    cursorPos = col + row * ROW_STRIDE;
  }
  
  void print(String string) {
    for (char c : string.toCharArray()) {
      contents[cursorPos] = c;
      cursorPos++;
      cursorPos %= ROW_STRIDE * 2;
    }
  }
  
  void display() {
    displaying = true;
  }
  
  void noDisplay() {
    displaying = false;
  }
  
  void scrollDisplayLeft() {
    scrollOffset++;
    if (scrollOffset >= ROW_STRIDE * 2) scrollOffset = 0;
  }
  
  void scrollDisplayRight() {
    scrollOffset--;
    if (scrollOffset < 0) scrollOffset = ROW_STRIDE * 2 - 1;
  }
  
  private String getRow(int row) {
    StringBuilder out = new StringBuilder();
    
    for (int i = 0; i < WIDTH; i++) {
      int contentIndex = i + scrollOffset + row * ROW_STRIDE;
      
      // Wrap index around if it would be out of bounds
      while (contentIndex < 0) contentIndex += ROW_STRIDE * 2;
      while (contentIndex >= ROW_STRIDE * 2) contentIndex -= ROW_STRIDE * 2;
      
      out.append(contents[contentIndex]);
    }
    
    return out.toString();
  }
  
  byte[][] fontdata = {
    {  0,   0,   0,   0,   0,   0,   0, }, // [ 0] ' '
    {  4,   4,   4,   4,   0,   0,   4, }, // [ 1] '!'
    { 10,  10,  10,   0,   0,   0,   0, }, // [ 2] '"'
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    {  0,   4,   8,  31,   8,   4,   0, }  // [191] 'ß'
  };
  
  void render(float x, float y, float w, float h) {
    if (displaying) {
      PGraphics display = createGraphics(WIDTH * 6 + 2, HEIGHT * 10 + 2);
      
      display.beginDraw();
      display.background(color(0, 0, 255));
      
      String line1 = this.getRow(0);
      String line2 = this.getRow(1);
      
      plotString(line1, 2, 2, display);
      plotString(line2, 2, 11, display);
      
      display.endDraw();
      
      image(display, x, y, w, h);
    }
  }
  
  private void plotString(String str, int x, int y, PGraphics display) {
    for (char c : str.toCharArray()) {
      byte[] charData = fontdata[c - 32];
      display.stroke(255);
      for (int row = 0; row < 7; row++) {
        byte line = charData[row];
        for (int col = 4; col >= 0; col--) {
          if ((line & 1) == 1) display.point(x + col, y + row);
          line >>= 1;
        }
      }
      x += 6;
    }
  }
}
